## arch/arm64/hotplug/Kconfig
```kconfig
config ALUCARD_HOTPLUG
        bool "Enable plugging down/up of cores as per demand"
        default n
        help
            This driver hotplugs cpu cores
```

## drivers/misc/mediatek/accelerometer/lsm6ds0_acc-new/Kconfig
```kconfig
config MTK_LSM6DS0_ACC_NEW
        bool "LSM6DS0_ACC for MediaTek package"
        default n
```

## drivers/misc/mediatek/magnetometer/qmc6983-new/Kconfig
```kconfig
config CONFIG_MTK_QMC6983_NEW
	bool "QMC6983_NEW for MediaTek package"
	default n
```
